## openaw/boards/openaw/a733_e902/a733_e902_defconfig
```kconfig
CONFIG_XIP=n
CONFIG_RISCV_SOC_INTERRUPT_INIT=y
CONFIG_SYS_CLOCK_TICKS_PER_SEC=1000
CONFIG_CONSOLE=n
CONFIG_SERIAL=n
CONFIG_PRINTK=n
CONFIG_TICKLESS_KERNEL=n
```

## openaw/soc/openaw/sun60i_e902/Kconfig
```kconfig
config SOC_SUN60I_E902
 select RISCV
 select RISCV_ISA_RV32E
 select RISCV_ISA_EXT_M
 select RISCV_ISA_EXT_C
 select RISCV_SOC_HAS_GP_RELATIVE_ADDRESSING
 select INCLUDE_RESET_VECTOR
 select GEN_SW_ISR_TABLE
```

## openaw/soc/openaw/sun60i_e902/Kconfig.defconfig
```kconfig
if SOC_SUN60I_E902
config RISCV_MCAUSE_EXCEPTION_MASK
 default 0xfff
config RISCV_TRAP_HANDLER_ALIGNMENT
 default 64
config NUM_IRQS
 default 208
config SYS_CLOCK_HW_CYCLES_PER_SEC
 default 1000
endif
```

## openaw/soc/openaw/sun60i_e902/Kconfig.soc
```kconfig
config SOC_SUN60I_E902
 bool
config SOC
 default "sun60i_e902" if SOC_SUN60I_E902
```
