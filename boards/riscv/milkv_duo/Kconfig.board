## boards/riscv/milkv_duo/Kconfig.board
```kconfig
# Copyright (c) 2021 Katsuhiro Suzuki
# SPDX-License-Identifier: Apache-2.0

config BOARD_MILKV_DUO
	bool "MILK-V DUO target"
	depends on SOC_RISCV_CV180X
```

## boards/riscv/milkv_duo/milkv_duo_defconfig
```kconfig
# SPDX-License-Identifier: Apache-2.0

CONFIG_SOC_SERIES_MILKV_CV180X=y
CONFIG_SOC_RISCV_CV1800B=y
CONFIG_BOARD_MILKV_DUO=y
CONFIG_CONSOLE=y
CONFIG_SERIAL=y
CONFIG_UART_SIFIVE_PORT_0=y
CONFIG_UART_CONSOLE=y
CONFIG_XIP=n
```

## drivers/serial/Kconfig.duo
```kconfig
# Milk-v Duo UART configuration option

# SPDX-License-Identifier: Apache-2.0

menuconfig UART_DUO
	bool "Duo serial driver"
	default y
	depends on DT_HAS_DUO_UART0_ENABLED
	select SERIAL_HAS_DRIVER
	help
	  This option enables DuoUART serial driver.

menuconfig UART_DUO_PORT_0
	bool "DUO Port 0"
	depends on UART_DUO
	help
	  This tells the driver to configure the UART port at boot, depending on
	  the additional configure options below.
```

## dts/bindings/serial/cvitek,uart0.yaml
```yaml
# Copyright (c) 2022, CVITEK Inc.
# SPDX-License-Identifier: Apache-2.0

description: CVITEK UART

compatible: "cvitek,uart0"

include: [uart-controller.yaml]

properties:
  reg:
    required: true

  interrupts:
    required: true
```

## soc/riscv/riscv-privileged/milkv/Kconfig.series
```kconfig
# SPDX-License-Identifier: Apache-2.0

config SOC_SERIES_MILKV_CV180X
	bool "MILKV CV180X series"
	select RISCV
	select SOC_FAMILY_RISCV_PRIVILEGED
	help
	  Enable support for Milk-V CV180X SoC Series.
```

## soc/riscv/riscv-privileged/milkv/Kconfig.soc
```kconfig
# Copyright (c) 2021 Rajnesh Kanwal <rajnesh.kanwal49@gmail.com>
# SPDX-License-Identifier: Apache-2.0

choice
	prompt "Milk-V CV180X SoC"
	depends on SOC_SERIES_MILKV_CV180X

config SOC_RISCV_CV1800B
	bool "Milk-V CV1800B"
	select ATOMIC_OPERATIONS_BUILTIN
	select INCLUDE_RESET_VECTOR
	select 64BIT
	select RISCV_ISA_RV64I
	select RISCV_ISA_EXT_M
	select RISCV_ISA_EXT_A
	select RISCV_ISA_EXT_C
	select RISCV_ISA_EXT_ZICSR
	select RISCV_ISA_EXT_ZIFENCEI

endchoice
```
